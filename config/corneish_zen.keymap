#define CONFIG_WIRELESS
#define ZMK_BASE_LAYER(name, LT, RT, LM, RM, LB, RB, LH, RH)                    \
    ZMK_LAYER(                                                                  \
        name,                                                                   \
                  LT RT                                                         \
                  LM RM                                                         \
                  LB RB                                                         \
         &kp LGUI LH RH &smart_mouse                                            \
    )

#include "zmk-helpers/key-labels/36.h"
#include "base.keymap"

// Select 5-column version (Corneish-Zen specific)
/{ chosen { zmk,physical-layout = &foostan_corne_5col_layout; }; };
